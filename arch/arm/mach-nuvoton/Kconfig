## arch/arm/mach-nuvoton/Kconfig
```kconfig
if ARCH_NUVOTON

config SYS_SOC
	default "nuvoton"

config SYS_VENDOR
	default "nuvoton"

config MA35D1
	select ARM64
	select DM
	select DM_ETH
	bool "Nuvoton MA35D1"
	default y

source "arch/arm/mach-nuvoton/ma35d1/Kconfig"
source "board/nuvoton/ma35d1/Kconfig"

endif
```

## arch/arm/mach-nuvoton/ma35d1/Kconfig
```kconfig
if MA35D1

choice
	prompt  "Nuvoton MA35D1 board select"
	optional

config TARGET_MA35D1_EVB
	bool "MA35D1 EVB"

config TARGET_MA35D1_IOT
	bool "MA35D1 IoT Board"

endchoice

endif
```

## board/nuvoton/ma35d1/Kconfig
```kconfig
if MA35D1

config SYS_BOARD
	default "ma35d1"

config SYS_VENDOR
	default "nuvoton"

config SYS_CONFIG_NAME
	default "ma35d1"

endif
```

## cmd/nuvoton/Kconfig
```kconfig
menu "Nuvoton specific command line interface"

config CMD_NU_AES
	bool "Enable the command for AES decrypt image"
	depends on MA35D1_CRYPTO
	help
	   Support decrypt the kernel image with Nuvoton
	   MA35D1 on-chip cryptographic accelerator. 

endmenu
```

## drivers/crypto/Kconfig
```kconfig
menu "Hardware crypto devices"

source drivers/crypto/hash/Kconfig
config MA35D1_CRYPTO
	bool "Nuvoton MA35D1 cryptographic accelerator."
	depends on MA35D1
	default y
	help
	  Enables support for the on-chip cryptographic accelerator on MA35D1.

source drivers/crypto/fsl/Kconfig

endmenu
```

## drivers/pinctrl/nuvoton/Kconfig
```kconfig
config PINCTRL_MA35D1
	bool "NUVOTON MA35D1 pin control drivers"
	depends on PINCTRL_GENERIC
	default y
	help
	  Enable support pin control functions for NVT SoCs.

config SPL_PINCTRL_MA35D1
	bool "Support NUVOTON MA35D1 pin controllers in SPL"
	depends on SPL_PINCTRL_GENERIC
	default y
	help
	  This option is an SPL-variant of the PINCTRL_NVT option.
```
